## target/rpi4.its
```
/*
 * Copyright (C) 2020 Daniel Rossier <daniel.rossier@heig-vd.ch>
 *
 * This program is free software; you can redistribute it and/or modify
 * it under the terms of the GNU General Public License version 2 as
 * published by the Free Software Foundation.
 *
 * This program is distributed in the hope that it will be useful,
 * but WITHOUT ANY WARRANTY; without even the implied warranty of
 * MERCHANTABILITY or FITNESS FOR A PARTICULAR PURPOSE.  See the
 * GNU General Public License for more details.
 *
 * You should have received a copy of the GNU General Public License
 * along with this program; if not, write to the Free Software
 * Foundation, Inc., 51 Franklin St, Fifth Floor, Boston, MA  02110-1301  USA
 *
 */

/dts-v1/;

/ {
	description = "Kernel and rootfs components for Raspberry Pi 4 environment";

	images {
		linux {
			description = "Linux kernel";
			data = /incbin/("../linux/linux/build/rpi4/arch/arm/boot/Image");
			type = "kernel";
			arch = "arm";
			os = "linux";
			compression = "none";
			load = <0x01008000>;
			entry = <0x01008000>;
		};

		fdt_linux {
			description = "Linux device tree blob";
			data = /incbin/("../linux/linux/build/rpi4/arch/arm/boot/dts/bcm2711-rpi-4-b.dtb");
			type = "flat_dt";
			arch = "arm";
			compression = "none";
			load = <0x10a00000>;
		};

		initrd {
			description = "Initial rootfs (initrd)";
			data = /incbin/("../rootfs/board/rpi4/initrd.cpio");
			type = "ramdisk";
			arch = "arm";
			os = "linux";
			compression = "none";
			load = <0x10c00000>;
		};
		so3 {
			description = "so3 kernel";
			data = /incbin/("../so3/so3/so3.bin");
			type ="kernel";
			arch = "arm";
			os = "linux";
			compression = "none";
			load = <0x01008000>;
			//entry = <0x41008000>;
		};
		so3_fdt {
			description = "so3 device tree blob";
			data = /incbin/("../so3/so3/dts/virt32.dtb");
			type = "flat_dt";
			arch = "arm";
			compression = "none";
			load = <0x04c00000>;
		};

		so3_rootfs {
			description = "so3 Rootfs";
			data = /incbin/("../rootfs/board/virt32/rootfs.fat");
			type = "ramdisk";
			arch = "arm";
			os = "linux";
			compression = "none";
			load = <0x04a00000>;
		};
	};

	configurations {
		default = "so3";

		conf_linux {
			description = "Linux on Raspberry Pi 4";
			kernel = "linux";
			fdt = "fdt_linux";
			ramdisk = "initrd";
		};
		so3 {
			description = "so3 kernel image including device tree";
			kernel = "so3";
			fdt = "so3_fdt";
			ramdisk = "so3_rootfs";
		};
	};

};
```

## target/virt32.its
```
/*
 * Copyright (C) 2014-2023 Daniel Rossier <daniel.rossier@heig-vd.ch>
 *
 * This program is free software; you can redistribute it and/or modify
 * it under the terms of the GNU General Public License version 2 as
 * published by the Free Software Foundation.
 *
 * This program is distributed in the hope that it will be useful,
 * but WITHOUT ANY WARRANTY; without even the implied warranty of
 * MERCHANTABILITY or FITNESS FOR A PARTICULAR PURPOSE.  See the
 * GNU General Public License for more details.
 *
 * You should have received a copy of the GNU General Public License
 * along with this program; if not, write to the Free Software
 * Foundation, Inc., 51 Franklin St, Fifth Floor, Boston, MA  02110-1301  USA
 *
 */

/dts-v1/;

/ {
	description = "Kernel and rootfs components for virt32 environment";

	images {

		linux {
			description = "Linux kernel";
			data = /incbin/("../linux/linux/build/virt32/arch/arm/boot/Image");
			type = "kernel";
			arch = "arm";
			os = "linux";
			compression = "none";
			load = <0x41008000>;
			entry = <0x41008000>;
		};

		fdt_linux {
			description = "Linux device tree blob";
			data = /incbin/("../linux/linux/build/virt32/arch/arm/boot/dts/virt32.dtb");
			type = "flat_dt";
			arch = "arm";
			compression = "none";
			load = <0x5a000000>;
		};

		initrd {
			description = "Initial rootfs (initrd)";
			data = /incbin/("../rootfs/board/virt32/initrd.cpio");
			type = "ramdisk";
			arch = "arm";
			os = "linux";
			compression = "none";
			load = <0x50c00000>;
		};
		so3 {
			description = "so3 kernel";
			data = /incbin/("../so3/so3/build/virt32/so3.bin");
			type ="kernel";
			arch = "arm";
			os = "linux";
			compression = "none";
			load = <0x41008000>;
			entry = <0x41008000>;
		};
		so3_fdt {
			description = "so3 device tree blob";
			data = /incbin/("../so3/so3/build/virt32/dts/virt32.dtb");
			type = "flat_dt";
			arch = "arm";
			compression = "none";
			load = <0x44a00000>;
		};

		so3_rootfs {
			description = "so3 Rootfs";
			data = /incbin/("../rootfs/board/virt32/rootfs.fat");
			type = "ramdisk";
			arch = "arm";
			os = "linux";
			compression = "none";
			load = <0x44c00000>;
		};

	};
	configurations {
		default = "so3";

		linux {
			description = "Linux kernel image including device tree";
			kernel = "linux";
			fdt = "fdt_linux";
			ramdisk = "initrd";
		};
		so3 {
			description = "so3 kernel image including device tree";
			kernel = "so3";
			fdt = "so3_fdt";
			ramdisk = "so3_rootfs";
		};
	};
};
```

## target/virt64.its
```
/dts-v1/;

/ {
	description = "Kernel and rootfs components for virt64 environment";

	images {

		linux {
			description = "Linux kernel";
			data = /incbin/("../linux/linux/build/virt64/arch/arm64/boot/Image");
			type = "avz";
			arch = "arm64";
			os = "linux";
			compression = "none";
			load = <0x41000000>;
			entry = <0x41000000>;
		};

		fdt_linux {
			description = "Linux device tree blob";
			data = /incbin/("../linux/linux/build/virt64/arch/arm64/boot/dts/arm/virt64.dtb");
			type = "flat_dt";
			arch = "arm64";
			compression = "none";
			load = <0x5a000000>;
		};

		initrd {
			description = "Initial rootfs (initrd)";
			data = /incbin/("../rootfs/board/virt64/initrd.cpio");
			type = "ramdisk";
			arch = "arm64";
			os = "linux";
			compression = "none";
			load = <0x50c00000>;
		};

		avz {
			description = "AVZ Hypervisor (64-bit) Polymorphic SO3";
			data = /incbin/("../avz/build/virt64/so3.bin");
			type = "kernel";
			os = "linux";
			arch = "arm64";
			compression = "none";
			load = <0x40080000>;
			entry = <0x40080000>;
		};
		avz_dt {
			description = "Flatenned Device Tree blob";
			data = /incbin/("../avz/build/virt64/dts/virt64_avz_pv.dtb");
			type = "avz_dt";
			arch = "arm64";
			compression = "none";
			load = <0x40b00000>;
		};



	};
	configurations {
		default = "linux_avz";

		linux {
			description = "Linux kernel image including device tree";
			kernel = "linux";
			fdt = "fdt_linux";
			ramdisk = "initrd";
		};

		linux_avz {
			description = "Linux kernel image including device tree running on AVZ";
			kernel = "avz";
			loadables = "avz_dt", "linux";
			fdt = "fdt_linux";
			ramdisk = "initrd";
		};
	};
};
```
